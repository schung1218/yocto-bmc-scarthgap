## meta-ma35h0/conf/distro/include/nvt-base.inc
```bitbake
# ma35h0 DISTRO for the FrameBuffer graphical backend.

DISTRO = "nvt-base"
DISTRO_NAME = "Nuvoton Release Distro"
DISTRO_VERSION = "4.0.15-scarthgap"

DISTRO_CODENAME = "scarthgap"
SDK_VENDOR = "-pokysdk"
SDK_VERSION := "${DISTRO_VERSION}"

MAINTAINER = "Nuvoton <www.nuvoton.com>"

TARGET_VENDOR = "-poky"

DISTRO = "nvt-ma35h0"


PREFERRED_PROVIDER:udev = "systemd"
PREFERRED_PROVIDER:udev-utils = "systemd"


# =========================================================================
# DISTRO features
# =========================================================================
DISTRO_FEATURES ?= " vc8000 dcultrafb gc520 directfb systemd alsa"
VIRTUAL-RUNTIME_init_manager = "systemd"
DISTRO_FEATURES_BACKFILL_CONSIDERED += "sysvinit"
```

## meta-ma35h0/conf/distro/nvt-openbmc.conf
```bitbake
# Nuvoton DISTRO for the openbmc backend.
require conf/distro/include/phosphor-base.inc
require conf/machine/include/obmc-bsp-common.inc
require conf/machine/include/obmc-evb-common.inc

FLASH_SIZE = "131072"

do_rootfs[vardepsexclude] = "TIME DATE DATETIME"
```
